#include <Arduino.h>
#include <math.h>
#include "DisplaysManager.h"
#include "CloudManager.h"
#include "DeskConfig.h"

#define SCREEN_WIDTH 128
#define SCREEN_HEIGHT 64
#define OLED_RESET    -1

// Instanciación real de los objetos asociados a sus respectivos buses
Adafruit_SSD1306 oledIzquierdo(SCREEN_WIDTH, SCREEN_HEIGHT, &Wire, OLED_RESET);
Adafruit_SSD1306 oledDerecho(SCREEN_WIDTH, SCREEN_HEIGHT, &Wire1, OLED_RESET);
const unsigned char iconoReloj[] PROGMEM = {
  0x00, 0x00, 0x00, 0x00, 0x00, 0x00, 0x00, 0x00, 0x00, 0x00, 0x00, 0x00, 0x00, 0x00, 0x00, 0x00,
	0x00, 0x00, 0x00, 0x1f, 0xf0, 0x00, 0x00, 0x00, 0x00, 0x00, 0x01, 0xff, 0xff, 0x80, 0x00, 0x00,
	0x00, 0x00, 0x0f, 0xff, 0xff, 0xf0, 0x00, 0x00, 0x00, 0x00, 0x3f, 0xff, 0xff, 0xfc, 0x00, 0x00,
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	0x00, 0x00, 0x00, 0x00, 0x00, 0x00, 0x00, 0x00, 0x00, 0x00, 0x00, 0x00, 0x00, 0x00, 0x00, 0x00
};
const unsigned char iconoSalud[] PROGMEM = {
  0x00, 0x00, 0x00, 0x00, 0x00, 0x00, 0x00, 0x00, 0x00, 0x00, 0x00, 0x00, 0x00, 0x00, 0x00, 0x00,
	0x00, 0x00, 0x00, 0x00, 0x00, 0x00, 0x00, 0x00, 0x00, 0x07, 0xff, 0x80, 0x01, 0xff, 0xe0, 0x00,
	0x00, 0x3f, 0xff, 0xe0, 0x07, 0xff, 0xf8, 0x00, 0x00, 0x7f, 0xff, 0xf8, 0x1f, 0xff, 0xfe, 0x00,
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	0x00, 0x00, 0x00, 0x00, 0x00, 0x00, 0x00, 0x00, 0x00, 0x00, 0x00, 0x00, 0x00, 0x00, 0x00, 0x00
};
const unsigned char iconoCogniGame[] PROGMEM = {
  0x00, 0x00, 0x00, 0x00, 0x00, 0x00, 0x00, 0x00, 0x00, 0x00, 0x0f, 0xf0, 0x0f, 0xf0, 0x00, 0x00,
	0x00, 0x00, 0x3f, 0xfc, 0x3f, 0xfc, 0x00, 0x00, 0x00, 0x00, 0x7f, 0xfe, 0x7f, 0xfe, 0x00, 0x00,
	0x00, 0x00, 0xff, 0xfe, 0x7f, 0xff, 0x00, 0x00, 0x00, 0x01, 0xff, 0xfe, 0x7f, 0xff, 0x80, 0x00,
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	0x00, 0x00, 0x1f, 0xf0, 0x0f, 0xf8, 0x00, 0x00, 0x00, 0x00, 0x00, 0x00, 0x00, 0x00, 0x00, 0x00
};
const unsigned char iconoTemperatura[] PROGMEM = {
  0x00, 0x00, 0x00, 0x1f, 0xf8, 0x00, 0x00, 0x00, 0x00, 0x00, 0x00, 0x3f, 0xfc, 0x00, 0x00, 0x00,
	0x00, 0x00, 0x00, 0xff, 0xff, 0x00, 0x00, 0x00, 0x00, 0x00, 0x01, 0xff, 0xff, 0x80, 0x00, 0x00,
	0x00, 0x00, 0x01, 0xff, 0xff, 0x80, 0x00, 0x00, 0x00, 0x00, 0x03, 0xfe, 0x7f, 0xc0, 0x00, 0x00,
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	0x00, 0x00, 0x00, 0xff, 0xff, 0x00, 0x00, 0x00, 0x00, 0x00, 0x00, 0x3f, 0xfc, 0x00, 0x00, 0x00
};
bool initDisplays(void) {
  // Inicializar ambos buses I2C físicos independientes
  Wire.begin(DESK_OLED_LEFT_SDA_GPIO, DESK_OLED_LEFT_SCL_GPIO);
  Wire1.begin(DESK_OLED_RIGHT_SDA_GPIO, DESK_OLED_RIGHT_SCL_GPIO);

  // Iniciar pantalla superior (Dirección 0x3C en Wire)
  if(!oledIzquierdo.begin(SSD1306_SWITCHCAPVCC, DESK_OLED_I2C_ADDRESS)) {
    Serial.println(F("Error crítico: No se detecta la OLED Izquierda"));
    return false;
  }

  // Iniciar pantalla inferior (Dirección 0x3C en Wire1)
  if(!oledDerecho.begin(SSD1306_SWITCHCAPVCC, DESK_OLED_I2C_ADDRESS)) {
    Serial.println(F("Error crítico: No se detecta la OLED Derecha"));
    return false;
  }

  // Limpiar buffers iniciales
  oledIzquierdo.clearDisplay();
  oledDerecho.clearDisplay();
  oledIzquierdo.display();
  oledDerecho.display();
  return true;
}

void mostrarSplashScreenALBA() {
  // --- PANTALLA IZQUIERDA: Dibuja "A . L ." ---
  oledIzquierdo.clearDisplay();

  // Marco estético exterior con esquinas redondeadas
  oledIzquierdo.drawRoundRect(0, 0, 128, 64, 6, SSD1306_WHITE);

  // Texto principal grande
  oledIzquierdo.setTextSize(3);                    // Tamaño grande
  oledIzquierdo.setTextColor(SSD1306_WHITE);
  oledIzquierdo.setCursor(30, 20);                  // Centrado visual en la izquierda
  oledIzquierdo.print(F("A.L."));

  // Pequeña etiqueta de sistema abajo
  oledIzquierdo.setTextSize(1);
  oledIzquierdo.setCursor(12, 50);
  oledIzquierdo.print(F("SISTEMA COGNITIVO"));

  oledIzquierdo.display();

  // --- PANTALLA DERECHA: Dibuja "B . A ." ---
  oledDerecho.clearDisplay();

  // Marco estético exterior simétrico
  oledDerecho.drawRoundRect(0, 0, 128, 64, 6, SSD1306_WHITE);

  // Texto principal grande
  oledDerecho.setTextSize(3);
  oledDerecho.setTextColor(SSD1306_WHITE);
  oledDerecho.setCursor(30, 20);
  oledDerecho.print(F("B.A."));

  // Pequeña etiqueta de versión abajo
  oledDerecho.setTextSize(1);
  oledDerecho.setCursor(35, 50);
  oledDerecho.print(F("V 1.0"));

  oledDerecho.display();
}
void mostrarOjosALBA() {
// --- OLEDIZQUIERDO (Ojo izquierdo + barra hacia la derecha) ---
  oledIzquierdo.clearDisplay();

  // Dibujar óvalo/ojo izquierdo (x, y, ancho, alto, radio de esquina)
  oledIzquierdo.fillRoundRect(60, 16, 28, 32, 12, SSD1306_WHITE);

  // Línea horizontal central que sale hacia el borde derecho (conectando con la otra pantalla)
  // Dibujamos 3 líneas juntas para darle grosor de "barra metálica"
  oledIzquierdo.drawLine(88, 31, 127, 31, SSD1306_WHITE);
  oledIzquierdo.drawLine(88, 32, 127, 32, SSD1306_WHITE);
  oledIzquierdo.drawLine(88, 33, 127, 33, SSD1306_WHITE);

  oledIzquierdo.display();

  // --- OLEDDERECHO (Barra desde la izquierda + ojo derecho) ---
  oledDerecho.clearDisplay();

  // Línea horizontal que entra desde el borde izquierdo
  oledDerecho.drawLine(0, 31, 40, 31, SSD1306_WHITE);
  oledDerecho.drawLine(0, 32, 40, 32, SSD1306_WHITE);
  oledDerecho.drawLine(0, 33, 40, 33, SSD1306_WHITE);

  // Dibujar óvalo/ojo derecho
  oledDerecho.fillRoundRect(40, 16, 28, 32, 12, SSD1306_WHITE);

  oledDerecho.display();
}
void mostrarOjosCerradosALBA() {
  // --- OLEDIZQUIERDO (Ojo cerrado: línea horizontal en lugar del óvalo relleno) ---
  oledIzquierdo.clearDisplay();


  // Barra metálica central continua
  oledIzquierdo.drawLine(60, 31, 127, 31, SSD1306_WHITE);
  oledIzquierdo.drawLine(60, 32, 127, 32, SSD1306_WHITE);
  oledIzquierdo.drawLine(60, 33, 127, 33, SSD1306_WHITE);
  oledIzquierdo.display();

  // --- OLEDDERECHO ---
  oledDerecho.clearDisplay();

  // Barra metálica continua
  oledDerecho.drawLine(0, 31, 68, 31, SSD1306_WHITE);
  oledDerecho.drawLine(0, 32, 68, 32, SSD1306_WHITE);
  oledDerecho.drawLine(0, 33, 68, 33, SSD1306_WHITE);


  oledDerecho.display();
}
static void limpiarPantalla(Adafruit_SSD1306 &oled) {
  oled.clearDisplay();
  oled.setTextSize(1);
  oled.setTextColor(SSD1306_WHITE);
}

static void escribirLinea(Adafruit_SSD1306 &oled, int y, const char *texto) {
  oled.setCursor(4, y);
  oled.println(texto);
}

void mostrarVista(const desk_view_t *vista, const environment_reading_t *ambiente,
                  const health_reading_t *salud) {
  if (vista == nullptr) return;

  if (vista->screen == DESK_SCREEN_SPLASH) {
    mostrarSplashScreenALBA();
    return;
  }
  if (vista->screen == DESK_SCREEN_IDLE) {
    if (vista->eyes_closed) mostrarOjosCerradosALBA();
    else mostrarOjosALBA();
    return;
  }

  limpiarPantalla(oledIzquierdo);
  limpiarPantalla(oledDerecho);

  if (vista->screen == DESK_SCREEN_MENU) {
    static const char *const opciones[DESK_MENU_ITEM_COUNT] = {
      "Sensor",
      "Salud",
      "CogniGame",
      "Reloj"
    };
    switch (vista->menu_selection) {
    case 0:
      oledIzquierdo.drawBitmap(32, 0, iconoTemperatura, 64, 64, SSD1306_WHITE);
      break;
    case 1:
      oledIzquierdo.drawBitmap(32, 0, iconoSalud, 64, 64, SSD1306_WHITE);
      break;
    case 2:
      oledIzquierdo.drawBitmap(32, 0, iconoCogniGame, 64, 64, SSD1306_WHITE);
      break;
    case 3:
      oledIzquierdo.drawBitmap(32, 0, iconoReloj, 64, 64, SSD1306_WHITE);
      break;
    default:
      oledIzquierdo.drawBitmap(32, 0, iconoTemperatura, 64, 64, SSD1306_WHITE);
      break;
    }
    oledDerecho.setTextSize(2);
    escribirLinea(oledDerecho, 10, opciones[vista->menu_selection]);
    oledDerecho.setTextSize(1);
    oledDerecho.setCursor(4, 38);
    oledDerecho.printf("Opcion %u/%u", vista->menu_selection + 1u,
                       DESK_MENU_ITEM_COUNT);
    escribirLinea(oledDerecho, 52, "IZQ/DER  OK");
  } else if (vista->screen == DESK_SCREEN_FALL_PROMPT) {
    oledIzquierdo.setTextSize(2);
    escribirLinea(oledIzquierdo, 20, "ALERTA");
    escribirLinea(oledDerecho, 8, "POSIBLE CAIDA");
    escribirLinea(oledDerecho, 26, "Estas bien?");
    escribirLinea(oledDerecho, 46, "OK: Estoy bien");
  } else if (vista->screen == DESK_SCREEN_FALL_CONFIRMED) {
    oledIzquierdo.drawCircle(64, 32, 24, SSD1306_WHITE);
    oledIzquierdo.drawLine(52, 32, 61, 41, SSD1306_WHITE);
    oledIzquierdo.drawLine(61, 41, 78, 22, SSD1306_WHITE);
    oledIzquierdo.display();
    escribirLinea(oledDerecho, 4, "CAIDA CONFIRMADA");
    const char *linea1 = "Aviso NO enviado";
    const char *linea2 = "Llama al cuidador";
    switch (cloudEstadoAviso()) {
      case CLOUD_SHOW_SENT:       linea1 = "Aviso ENVIADO";    linea2 = "al cuidador"; break;
      case CLOUD_SHOW_SENDING:    linea1 = "Enviando aviso";   linea2 = "al cuidador..."; break;
      case CLOUD_SHOW_NO_NETWORK: linea1 = "SIN RED: aviso";   linea2 = "en cola, reintenta"; break;
      case CLOUD_SHOW_CLOUD_OFF:  linea1 = "Nube sin configurar"; linea2 = "Llama al cuidador"; break;
      case CLOUD_SHOW_NOT_SENT:
      default: break;
    }
    escribirLinea(oledDerecho, 22, linea1);
    escribirLinea(oledDerecho, 38, linea2);
    escribirLinea(oledDerecho, 54, "OK: Continuar");
  } else if (vista->screen == DESK_SCREEN_ENVIRONMENT) {
    escribirLinea(oledIzquierdo, 4, "AMBIENTE");
    escribirLinea(oledDerecho, 4, "DHT11");
    if (ambiente == nullptr || !ambiente->valid) {
      escribirLinea(oledIzquierdo, 24, "Sin lectura");
      escribirLinea(oledDerecho, 24, "Revisar sensor");
    } else {
      char value[24];
      snprintf(value, sizeof(value), "Temp: %.1f C", ambiente->temperature_c);
      escribirLinea(oledIzquierdo, 24, value);
      snprintf(value, sizeof(value), "Humedad: %.0f%%", ambiente->humidity_pct);
      escribirLinea(oledDerecho, 24, value);
    }
    escribirLinea(oledDerecho, 48, "IZQ: Volver");
  } else if (vista->screen == DESK_SCREEN_GAME) {
    const game_view_t &juego = vista->game;
    static const char *const prefijos[GAME_OPTIONS] = {"IZQ ", "OK  ", "DER "};
    if (juego.state == GAME_STATE_INTRO) {
      oledIzquierdo.drawBitmap(32, 0, iconoCogniGame, 64, 64, SSD1306_WHITE);
      oledDerecho.setTextSize(2);
      escribirLinea(oledDerecho, 2, "Vamos a");
      escribirLinea(oledDerecho, 20, "jugar!");
      oledDerecho.setTextSize(1);
      escribirLinea(oledDerecho, 42, "OK: Empezar");
      escribirLinea(oledDerecho, 54, "IZQ: Volver");
    } else if ((juego.state == GAME_STATE_QUESTION || juego.state == GAME_STATE_FEEDBACK) &&
               juego.question != nullptr) {
      char value[24];
      snprintf(value, sizeof(value), "Pregunta %u de %u", static_cast<unsigned>(juego.number),
               static_cast<unsigned>(juego.total));
      escribirLinea(oledIzquierdo, 0, value);
      if (juego.state == GAME_STATE_QUESTION) {
        for (uint8_t i = 0u; i < GAME_QUESTION_LINES; ++i) {
          if (juego.question->lines[i] != nullptr) {
            escribirLinea(oledIzquierdo, static_cast<int>(16u + 11u * i), juego.question->lines[i]);
          }
        }
        for (uint8_t i = 0u; i < GAME_OPTIONS; ++i) {
          snprintf(value, sizeof(value), "%s%s", prefijos[i], juego.question->options[i]);
          escribirLinea(oledDerecho, static_cast<int>(8u + 18u * i), value);
        }
      } else {
        oledIzquierdo.setTextSize(2);
        escribirLinea(oledIzquierdo, 24, juego.last_correct ? "Correcto!" : "Casi!");
        oledIzquierdo.setTextSize(1);
        if (juego.last_correct) {
          escribirLinea(oledDerecho, 20, "Muy bien, sigue");
          escribirLinea(oledDerecho, 32, "asi.");
        } else {
          escribirLinea(oledDerecho, 14, "La respuesta era:");
          escribirLinea(oledDerecho, 28, juego.question->options[juego.question->correct]);
        }
        escribirLinea(oledDerecho, 54, "OK: Siguiente");
      }
    } else if (juego.state == GAME_STATE_RESULT) {
      char value[24];
      escribirLinea(oledIzquierdo, 4, "RESULTADO");
      oledIzquierdo.setTextSize(2);
      snprintf(value, sizeof(value), "%u de %u", static_cast<unsigned>(juego.score),
               static_cast<unsigned>(juego.total));
      escribirLinea(oledIzquierdo, 24, value);
      oledIzquierdo.setTextSize(1);
      escribirLinea(oledDerecho, 4, juego.score >= 4u ? "Excelente!"
                                   : juego.score >= 2u ? "Muy bien!"
                                                       : "Sigamos practicando");
      snprintf(value, sizeof(value), "Tiempo medio: %lu s",
               static_cast<unsigned long>((juego.avg_ms + 500u) / 1000u));
      escribirLinea(oledDerecho, 24, value);
      escribirLinea(oledDerecho, 54, "OK: Volver");
    }
  } else if (vista->screen == DESK_SCREEN_HEALTH) {
    if (salud == nullptr || !salud->online) {
      escribirLinea(oledDerecho, 4, "SALUD");
      escribirLinea(oledDerecho, 22, "Sin senal de la");
      escribirLinea(oledDerecho, 34, "pulsera");
      escribirLinea(oledIzquierdo, 52, "Revisa que este");
    } else {
      char value[24];
      escribirLinea(oledIzquierdo, 4, "PULSO");
      oledIzquierdo.setTextSize(2);
      if (salud->bpm_valid) snprintf(value, sizeof(value), "%u bpm", static_cast<unsigned>(salud->bpm));
      else snprintf(value, sizeof(value), "-- bpm");
      oledIzquierdo.setCursor(20, 24);
      oledIzquierdo.print(value);
      oledIzquierdo.setTextSize(1);

      escribirLinea(oledDerecho, 4, "OXIGENO (SpO2)");
      oledDerecho.setTextSize(2);
      if (salud->spo2_valid) snprintf(value, sizeof(value), "%u %%", static_cast<unsigned>(salud->spo2));
      else snprintf(value, sizeof(value), "-- %%");
      oledDerecho.setCursor(20, 18);
      oledDerecho.print(value);
      oledDerecho.setTextSize(1);
      if (salud->bat_valid) snprintf(value, sizeof(value), "Bateria: %u%%", static_cast<unsigned>(salud->bat_pct));
      else snprintf(value, sizeof(value), "Bateria: --");
      escribirLinea(oledDerecho, 38, value);
      if (!salud->bpm_valid || !salud->spo2_valid) escribirLinea(oledIzquierdo, 52, "Sin lectura: ponla");
    }
    escribirLinea(oledDerecho, 54, "IZQ: Volver");
  } else if (vista->screen == DESK_SCREEN_CLOCK) {
    oledIzquierdo.drawBitmap(32, 0, iconoReloj, 64, 64, SSD1306_WHITE);
    escribirLinea(oledDerecho, 2, "RELOJ");
    oledDerecho.setTextSize(2);
    oledDerecho.setCursor(20, 16);
    if (vista->clock_valid) {
      oledDerecho.printf("%02u:%02u", vista->clock_hour, vista->clock_minute);
    } else {
      escribirLinea(oledDerecho, 20, "--:--");
    }
    oledDerecho.setTextSize(1);
    const desk_alarm_t &alarm = vista->alarms[vista->selected_alarm];
    oledDerecho.setCursor(0, 40);
    oledDerecho.printf("Alarma %u %02u:%02u %s",
                       static_cast<unsigned>(vista->selected_alarm + 1u),
                       alarm.hour, alarm.minute, alarm.enabled ? "ON" : "OFF");
    escribirLinea(oledDerecho, 52, "IZQ: menu  DER: sig");
    escribirLinea(oledIzquierdo, 52, "OK: Editar");
  } else if (vista->screen == DESK_SCREEN_ALARM_EDIT) {
    escribirLinea(oledIzquierdo, 8, "ALARMA");
    oledIzquierdo.setCursor(50, 25);
    oledIzquierdo.printf("%u", static_cast<unsigned>(vista->selected_alarm + 1u));

    const desk_alarm_t &alarm = vista->alarms[vista->selected_alarm];
    escribirLinea(oledDerecho, 2, "AJUSTAR ALARMA");
    oledDerecho.setTextSize(2);
    oledDerecho.setCursor(25, 20);
    oledDerecho.printf("%02u:%02u", alarm.hour, alarm.minute);
    oledDerecho.setTextSize(1);
    if (vista->alarm_edit_field == 0u) {
      oledDerecho.drawRect(22, 18, 30, 21, SSD1306_WHITE);
    } else if (vista->alarm_edit_field == 1u) {
      oledDerecho.drawRect(58, 18, 30, 21, SSD1306_WHITE);
    } else {
      oledDerecho.drawRect(27, 43, 74, 15, SSD1306_WHITE);
    }
    oledDerecho.setCursor(29, 47);
    oledDerecho.printf("Aviso: %s", alarm.enabled ? "SI" : "NO");
    escribirLinea(oledIzquierdo, 46, "IZQ/DER: cambiar");
    escribirLinea(oledIzquierdo, 56, "OK: avanza/guarda");
  } else if (vista->screen == DESK_SCREEN_WAKE) {
    // Sol en el OLED izquierdo.
    oledIzquierdo.fillCircle(64, 32, 12, SSD1306_WHITE);
    for (int i = 0; i < 8; ++i) {
      const float angulo = static_cast<float>(i) * 0.7853982f;
      const int x1 = 64 + static_cast<int>(18.0f * cosf(angulo));
      const int y1 = 32 + static_cast<int>(18.0f * sinf(angulo));
      const int x2 = 64 + static_cast<int>(26.0f * cosf(angulo));
      const int y2 = 32 + static_cast<int>(26.0f * sinf(angulo));
      oledIzquierdo.drawLine(x1, y1, x2, y2, SSD1306_WHITE);
    }
    escribirLinea(oledDerecho, 4, "BUENOS DIAS");
    if (vista->clock_valid) {
      oledDerecho.setCursor(4, 20);
      oledDerecho.printf("Son las %02u:%02u", static_cast<unsigned>(vista->clock_hour),
                         static_cast<unsigned>(vista->clock_minute));
    }
    escribirLinea(oledDerecho, 34, "Hora de su medicina");
    escribirLinea(oledDerecho, 54, "OK:Jugar IZQ:Luego");
  } else if (vista->screen == DESK_SCREEN_MEDICATION_ALERT) {
    oledIzquierdo.drawRoundRect(20, 8, 88, 48, 8, SSD1306_WHITE);
    oledIzquierdo.drawLine(64, 18, 64, 46, SSD1306_WHITE);
    oledIzquierdo.drawLine(50, 32, 78, 32, SSD1306_WHITE);
    oledDerecho.setTextSize(1);
    oledDerecho.setCursor(0, 8);
    oledDerecho.printf("MEDICAMENTO %u",
                       static_cast<unsigned>(vista->medication_alarm_index + 1u));
    escribirLinea(oledDerecho, 32, "Hora de tomarlo");
    escribirLinea(oledDerecho, 50, "OK: Confirmar");
  } else {
    static const char *const titulos[DESK_MENU_ITEM_COUNT] = {
      "Sensor",
      "Salud",
      "CogniGame",
      "Reloj"
    };
    oledIzquierdo.setTextSize(1);
    escribirLinea(oledIzquierdo, 12, titulos[vista->menu_selection]);
    if (vista->menu_selection == 1u) {
      escribirLinea(oledDerecho, 8, "SALUD");
      escribirLinea(oledDerecho, 24, "Esperando datos");
      escribirLinea(oledDerecho, 40, "de Cogni Band");
    } else if (vista->menu_selection == 2u) {
      escribirLinea(oledDerecho, 8, "COGNIGAME");
      escribirLinea(oledDerecho, 24, "Prototipo");
      escribirLinea(oledDerecho, 40, "pendiente");
    }
    escribirLinea(oledDerecho, 54, "IZQ: Volver");
  }

  oledIzquierdo.display();
  oledDerecho.display();
}